## disas/Kconfig
```kconfig
config ALPHA_DIS
    bool

config ARM_DIS
    bool

config AVR_DIS
    bool

config HEXAGON_DIS
    bool

config HPPA_DIS
    bool

config I386_DIS
    bool

config LOONGARCH_DIS
    bool

config M68K_DIS
    bool

config MICROBLAZE_DIS
    bool

config MIPS_DIS
    bool

config OPENRISC_DIS
    bool

config PPC_DIS
    bool

config RISCV_DIS
    bool

config RX_DIS
    bool

config S390_DIS
    bool

config SH4_DIS
    bool

config SPARC_DIS
    bool

config TRICORE_DIS
    bool

config XTENSA_DIS
    bool
```

## hw/gpio/Kconfig
```kconfig
config PL061
    bool

config GPIO_KEY
    bool

config GPIO_MPC8XXX
    bool

config GPIO_PWR
    bool

config SIFIVE_GPIO
    bool

config PCA_I2C_GPIO
    bool
    depends on I2C
    default y if I2C_DEVICES

config STM32L4X5_GPIO
    bool

config PCF8574
    bool
    depends on I2C

config ZAURUS_SCOOP
    bool
```

## target/microblaze/Kconfig
```kconfig
config MICROBLAZE
    bool
    select MICROBLAZE_DIS
    select DEVICE_TREE # needed by boot.c
```

## target/mips/Kconfig
```kconfig
config MIPS
    bool
    select MIPS_DIS
    imply SEMIHOSTING if TCG

config MIPS64
    bool
    select MIPS
```

## target/openrisc/Kconfig
```kconfig
config OPENRISC
    bool
    select OPENRISC_DIS
    select DEVICE_TREE # needed by boot.c
```

## target/riscv/Kconfig
```kconfig
config RISCV32
    bool
    select RISCV_DIS
    select ARM_COMPATIBLE_SEMIHOSTING if TCG
    select DEVICE_TREE # needed by boot.c

config RISCV64
    bool
    select RISCV_DIS
    select ARM_COMPATIBLE_SEMIHOSTING if TCG
    select DEVICE_TREE # needed by boot.c
```

## target/s390x/Kconfig
```kconfig
config S390X
    bool
    select S390_DIS
    select PCI
    select S390_FLIC

config S390X_LEGACY_CPUS
    bool
    default y
    depends on S390X
```

## target/sh4/Kconfig
```kconfig
config SH4
    bool
    select SH4_DIS
    # needed for sh_intc_get_pending_vector
    select SH_INTC
```

## target/sparc/Kconfig
```kconfig
config SPARC
    bool
    select SPARC_DIS

config SPARC64
    bool
    select SPARC_DIS
```
